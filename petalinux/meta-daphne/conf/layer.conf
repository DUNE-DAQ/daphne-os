## petalinux/meta-daphne/conf/layer.conf
```bitbake
# Minimal Yocto layer registration for repo-owned DAPHNE platform packaging.

BBPATH .= ":${LAYERDIR}"
BBFILES += "${LAYERDIR}/recipes-*/*/*.bb ${LAYERDIR}/recipes-*/*/*.bbappend"

BBFILE_COLLECTIONS += "daphne"
BBFILE_PATTERN_daphne := "^${LAYERDIR}/"
BBFILE_PRIORITY_daphne = "8"

LAYERSERIES_COMPAT_daphne = "langdale scarthgap"
```
